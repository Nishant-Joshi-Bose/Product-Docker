    IF :LNOT::DEF:INCLUDED_CYFITTERRV_INC
INCLUDED_CYFITTERRV_INC EQU 1
    GET cydevicerv_trm.inc

; I2CS_SCB
I2CS_SCB__CTRL EQU CYREG_SCB0_CTRL
I2CS_SCB__EZ_DATA0 EQU CYREG_SCB0_EZ_DATA0
I2CS_SCB__EZ_DATA1 EQU CYREG_SCB0_EZ_DATA1
I2CS_SCB__EZ_DATA10 EQU CYREG_SCB0_EZ_DATA10
I2CS_SCB__EZ_DATA11 EQU CYREG_SCB0_EZ_DATA11
I2CS_SCB__EZ_DATA12 EQU CYREG_SCB0_EZ_DATA12
I2CS_SCB__EZ_DATA13 EQU CYREG_SCB0_EZ_DATA13
I2CS_SCB__EZ_DATA14 EQU CYREG_SCB0_EZ_DATA14
I2CS_SCB__EZ_DATA15 EQU CYREG_SCB0_EZ_DATA15
I2CS_SCB__EZ_DATA16 EQU CYREG_SCB0_EZ_DATA16
I2CS_SCB__EZ_DATA17 EQU CYREG_SCB0_EZ_DATA17
I2CS_SCB__EZ_DATA18 EQU CYREG_SCB0_EZ_DATA18
I2CS_SCB__EZ_DATA19 EQU CYREG_SCB0_EZ_DATA19
I2CS_SCB__EZ_DATA2 EQU CYREG_SCB0_EZ_DATA2
I2CS_SCB__EZ_DATA20 EQU CYREG_SCB0_EZ_DATA20
I2CS_SCB__EZ_DATA21 EQU CYREG_SCB0_EZ_DATA21
I2CS_SCB__EZ_DATA22 EQU CYREG_SCB0_EZ_DATA22
I2CS_SCB__EZ_DATA23 EQU CYREG_SCB0_EZ_DATA23
I2CS_SCB__EZ_DATA24 EQU CYREG_SCB0_EZ_DATA24
I2CS_SCB__EZ_DATA25 EQU CYREG_SCB0_EZ_DATA25
I2CS_SCB__EZ_DATA26 EQU CYREG_SCB0_EZ_DATA26
I2CS_SCB__EZ_DATA27 EQU CYREG_SCB0_EZ_DATA27
I2CS_SCB__EZ_DATA28 EQU CYREG_SCB0_EZ_DATA28
I2CS_SCB__EZ_DATA29 EQU CYREG_SCB0_EZ_DATA29
I2CS_SCB__EZ_DATA3 EQU CYREG_SCB0_EZ_DATA3
I2CS_SCB__EZ_DATA30 EQU CYREG_SCB0_EZ_DATA30
I2CS_SCB__EZ_DATA31 EQU CYREG_SCB0_EZ_DATA31
I2CS_SCB__EZ_DATA4 EQU CYREG_SCB0_EZ_DATA4
I2CS_SCB__EZ_DATA5 EQU CYREG_SCB0_EZ_DATA5
I2CS_SCB__EZ_DATA6 EQU CYREG_SCB0_EZ_DATA6
I2CS_SCB__EZ_DATA7 EQU CYREG_SCB0_EZ_DATA7
I2CS_SCB__EZ_DATA8 EQU CYREG_SCB0_EZ_DATA8
I2CS_SCB__EZ_DATA9 EQU CYREG_SCB0_EZ_DATA9
I2CS_SCB__I2C_CFG EQU CYREG_SCB0_I2C_CFG
I2CS_SCB__I2C_CTRL EQU CYREG_SCB0_I2C_CTRL
I2CS_SCB__I2C_M_CMD EQU CYREG_SCB0_I2C_M_CMD
I2CS_SCB__I2C_S_CMD EQU CYREG_SCB0_I2C_S_CMD
I2CS_SCB__I2C_STATUS EQU CYREG_SCB0_I2C_STATUS
I2CS_SCB__INTR_CAUSE EQU CYREG_SCB0_INTR_CAUSE
I2CS_SCB__INTR_I2C_EC EQU CYREG_SCB0_INTR_I2C_EC
I2CS_SCB__INTR_I2C_EC_MASK EQU CYREG_SCB0_INTR_I2C_EC_MASK
I2CS_SCB__INTR_I2C_EC_MASKED EQU CYREG_SCB0_INTR_I2C_EC_MASKED
I2CS_SCB__INTR_M EQU CYREG_SCB0_INTR_M
I2CS_SCB__INTR_M_MASK EQU CYREG_SCB0_INTR_M_MASK
I2CS_SCB__INTR_M_MASKED EQU CYREG_SCB0_INTR_M_MASKED
I2CS_SCB__INTR_M_SET EQU CYREG_SCB0_INTR_M_SET
I2CS_SCB__INTR_RX EQU CYREG_SCB0_INTR_RX
I2CS_SCB__INTR_RX_MASK EQU CYREG_SCB0_INTR_RX_MASK
I2CS_SCB__INTR_RX_MASKED EQU CYREG_SCB0_INTR_RX_MASKED
I2CS_SCB__INTR_RX_SET EQU CYREG_SCB0_INTR_RX_SET
I2CS_SCB__INTR_S EQU CYREG_SCB0_INTR_S
I2CS_SCB__INTR_S_MASK EQU CYREG_SCB0_INTR_S_MASK
I2CS_SCB__INTR_S_MASKED EQU CYREG_SCB0_INTR_S_MASKED
I2CS_SCB__INTR_S_SET EQU CYREG_SCB0_INTR_S_SET
I2CS_SCB__INTR_SPI_EC EQU CYREG_SCB0_INTR_SPI_EC
I2CS_SCB__INTR_SPI_EC_MASK EQU CYREG_SCB0_INTR_SPI_EC_MASK
I2CS_SCB__INTR_SPI_EC_MASKED EQU CYREG_SCB0_INTR_SPI_EC_MASKED
I2CS_SCB__INTR_TX EQU CYREG_SCB0_INTR_TX
I2CS_SCB__INTR_TX_MASK EQU CYREG_SCB0_INTR_TX_MASK
I2CS_SCB__INTR_TX_MASKED EQU CYREG_SCB0_INTR_TX_MASKED
I2CS_SCB__INTR_TX_SET EQU CYREG_SCB0_INTR_TX_SET
I2CS_SCB__RX_CTRL EQU CYREG_SCB0_RX_CTRL
I2CS_SCB__RX_FIFO_CTRL EQU CYREG_SCB0_RX_FIFO_CTRL
I2CS_SCB__RX_FIFO_RD EQU CYREG_SCB0_RX_FIFO_RD
I2CS_SCB__RX_FIFO_RD_SILENT EQU CYREG_SCB0_RX_FIFO_RD_SILENT
I2CS_SCB__RX_FIFO_STATUS EQU CYREG_SCB0_RX_FIFO_STATUS
I2CS_SCB__RX_MATCH EQU CYREG_SCB0_RX_MATCH
I2CS_SCB__SPI_CTRL EQU CYREG_SCB0_SPI_CTRL
I2CS_SCB__SPI_STATUS EQU CYREG_SCB0_SPI_STATUS
I2CS_SCB__SS0_POSISTION EQU 0
I2CS_SCB__SS1_POSISTION EQU 1
I2CS_SCB__SS2_POSISTION EQU 2
I2CS_SCB__SS3_POSISTION EQU 3
I2CS_SCB__STATUS EQU CYREG_SCB0_STATUS
I2CS_SCB__TX_CTRL EQU CYREG_SCB0_TX_CTRL
I2CS_SCB__TX_FIFO_CTRL EQU CYREG_SCB0_TX_FIFO_CTRL
I2CS_SCB__TX_FIFO_STATUS EQU CYREG_SCB0_TX_FIFO_STATUS
I2CS_SCB__TX_FIFO_WR EQU CYREG_SCB0_TX_FIFO_WR
I2CS_SCB__UART_CTRL EQU CYREG_SCB0_UART_CTRL
I2CS_SCB__UART_FLOW_CTRL EQU CYREG_SCB0_UART_FLOW_CTRL
I2CS_SCB__UART_RX_CTRL EQU CYREG_SCB0_UART_RX_CTRL
I2CS_SCB__UART_RX_STATUS EQU CYREG_SCB0_UART_RX_STATUS
I2CS_SCB__UART_TX_CTRL EQU CYREG_SCB0_UART_TX_CTRL

; I2CS_SCB_IRQ
I2CS_SCB_IRQ__INTC_CLR_EN_REG EQU CYREG_CM0P_ICER
I2CS_SCB_IRQ__INTC_CLR_PD_REG EQU CYREG_CM0P_ICPR
I2CS_SCB_IRQ__INTC_MASK EQU 0x80
I2CS_SCB_IRQ__INTC_NUMBER EQU 7
I2CS_SCB_IRQ__INTC_PRIOR_MASK EQU 0xC0000000
I2CS_SCB_IRQ__INTC_PRIOR_NUM EQU 3
I2CS_SCB_IRQ__INTC_PRIOR_REG EQU CYREG_CM0P_IPR1
I2CS_SCB_IRQ__INTC_SET_EN_REG EQU CYREG_CM0P_ISER
I2CS_SCB_IRQ__INTC_SET_PD_REG EQU CYREG_CM0P_ISPR

; I2CS_SCBCLK
I2CS_SCBCLK__CTRL_REGISTER EQU CYREG_PERI_PCLK_CTL0
I2CS_SCBCLK__DIV_ID EQU 0x00000043
I2CS_SCBCLK__DIV_REGISTER EQU CYREG_PERI_DIV_16_CTL3
I2CS_SCBCLK__PA_DIV_ID EQU 0x000000FF

; I2CS_scl
I2CS_scl__0__DR EQU CYREG_GPIO_PRT4_DR
I2CS_scl__0__DR_CLR EQU CYREG_GPIO_PRT4_DR_CLR
I2CS_scl__0__DR_INV EQU CYREG_GPIO_PRT4_DR_INV
I2CS_scl__0__DR_SET EQU CYREG_GPIO_PRT4_DR_SET
I2CS_scl__0__HSIOM EQU CYREG_HSIOM_PORT_SEL4
I2CS_scl__0__HSIOM_GPIO EQU 0
I2CS_scl__0__HSIOM_I2C EQU 14
I2CS_scl__0__HSIOM_I2C_SCL EQU 14
I2CS_scl__0__HSIOM_MASK EQU 0x0000000F
I2CS_scl__0__HSIOM_SHIFT EQU 0
I2CS_scl__0__HSIOM_SPI EQU 15
I2CS_scl__0__HSIOM_SPI_MOSI EQU 15
I2CS_scl__0__HSIOM_UART EQU 9
I2CS_scl__0__HSIOM_UART_RX EQU 9
I2CS_scl__0__INTCFG EQU CYREG_GPIO_PRT4_INTR_CFG
I2CS_scl__0__INTR EQU CYREG_GPIO_PRT4_INTR
I2CS_scl__0__INTR_CFG EQU CYREG_GPIO_PRT4_INTR_CFG
I2CS_scl__0__INTSTAT EQU CYREG_GPIO_PRT4_INTR
I2CS_scl__0__MASK EQU 0x01
I2CS_scl__0__PC EQU CYREG_GPIO_PRT4_PC
I2CS_scl__0__PC2 EQU CYREG_GPIO_PRT4_PC2
I2CS_scl__0__PORT EQU 4
I2CS_scl__0__PS EQU CYREG_GPIO_PRT4_PS
I2CS_scl__0__SHIFT EQU 0
I2CS_scl__DR EQU CYREG_GPIO_PRT4_DR
I2CS_scl__DR_CLR EQU CYREG_GPIO_PRT4_DR_CLR
I2CS_scl__DR_INV EQU CYREG_GPIO_PRT4_DR_INV
I2CS_scl__DR_SET EQU CYREG_GPIO_PRT4_DR_SET
I2CS_scl__INTCFG EQU CYREG_GPIO_PRT4_INTR_CFG
I2CS_scl__INTR EQU CYREG_GPIO_PRT4_INTR
I2CS_scl__INTR_CFG EQU CYREG_GPIO_PRT4_INTR_CFG
I2CS_scl__INTSTAT EQU CYREG_GPIO_PRT4_INTR
I2CS_scl__MASK EQU 0x01
I2CS_scl__PC EQU CYREG_GPIO_PRT4_PC
I2CS_scl__PC2 EQU CYREG_GPIO_PRT4_PC2
I2CS_scl__PORT EQU 4
I2CS_scl__PS EQU CYREG_GPIO_PRT4_PS
I2CS_scl__SHIFT EQU 0

; I2CS_sda
I2CS_sda__0__DR EQU CYREG_GPIO_PRT4_DR
I2CS_sda__0__DR_CLR EQU CYREG_GPIO_PRT4_DR_CLR
I2CS_sda__0__DR_INV EQU CYREG_GPIO_PRT4_DR_INV
I2CS_sda__0__DR_SET EQU CYREG_GPIO_PRT4_DR_SET
I2CS_sda__0__HSIOM EQU CYREG_HSIOM_PORT_SEL4
I2CS_sda__0__HSIOM_GPIO EQU 0
I2CS_sda__0__HSIOM_I2C EQU 14
I2CS_sda__0__HSIOM_I2C_SDA EQU 14
I2CS_sda__0__HSIOM_MASK EQU 0x000000F0
I2CS_sda__0__HSIOM_SHIFT EQU 4
I2CS_sda__0__HSIOM_SPI EQU 15
I2CS_sda__0__HSIOM_SPI_MISO EQU 15
I2CS_sda__0__HSIOM_UART EQU 9
I2CS_sda__0__HSIOM_UART_TX EQU 9
I2CS_sda__0__INTCFG EQU CYREG_GPIO_PRT4_INTR_CFG
I2CS_sda__0__INTR EQU CYREG_GPIO_PRT4_INTR
I2CS_sda__0__INTR_CFG EQU CYREG_GPIO_PRT4_INTR_CFG
I2CS_sda__0__INTSTAT EQU CYREG_GPIO_PRT4_INTR
I2CS_sda__0__MASK EQU 0x02
I2CS_sda__0__PC EQU CYREG_GPIO_PRT4_PC
I2CS_sda__0__PC2 EQU CYREG_GPIO_PRT4_PC2
I2CS_sda__0__PORT EQU 4
I2CS_sda__0__PS EQU CYREG_GPIO_PRT4_PS
I2CS_sda__0__SHIFT EQU 1
I2CS_sda__DR EQU CYREG_GPIO_PRT4_DR
I2CS_sda__DR_CLR EQU CYREG_GPIO_PRT4_DR_CLR
I2CS_sda__DR_INV EQU CYREG_GPIO_PRT4_DR_INV
I2CS_sda__DR_SET EQU CYREG_GPIO_PRT4_DR_SET
I2CS_sda__INTCFG EQU CYREG_GPIO_PRT4_INTR_CFG
I2CS_sda__INTR EQU CYREG_GPIO_PRT4_INTR
I2CS_sda__INTR_CFG EQU CYREG_GPIO_PRT4_INTR_CFG
I2CS_sda__INTSTAT EQU CYREG_GPIO_PRT4_INTR
I2CS_sda__MASK EQU 0x02
I2CS_sda__PC EQU CYREG_GPIO_PRT4_PC
I2CS_sda__PC2 EQU CYREG_GPIO_PRT4_PC2
I2CS_sda__PORT EQU 4
I2CS_sda__PS EQU CYREG_GPIO_PRT4_PS
I2CS_sda__SHIFT EQU 1

; SPIM_mosi_m
SPIM_mosi_m__0__DR EQU CYREG_GPIO_PRT3_DR
SPIM_mosi_m__0__DR_CLR EQU CYREG_GPIO_PRT3_DR_CLR
SPIM_mosi_m__0__DR_INV EQU CYREG_GPIO_PRT3_DR_INV
SPIM_mosi_m__0__DR_SET EQU CYREG_GPIO_PRT3_DR_SET
SPIM_mosi_m__0__HSIOM EQU CYREG_HSIOM_PORT_SEL3
SPIM_mosi_m__0__HSIOM_GPIO EQU 0
SPIM_mosi_m__0__HSIOM_I2C EQU 14
SPIM_mosi_m__0__HSIOM_I2C_SCL EQU 14
SPIM_mosi_m__0__HSIOM_MASK EQU 0x0000000F
SPIM_mosi_m__0__HSIOM_SHIFT EQU 0
SPIM_mosi_m__0__HSIOM_SPI EQU 15
SPIM_mosi_m__0__HSIOM_SPI_MOSI EQU 15
SPIM_mosi_m__0__HSIOM_UART EQU 9
SPIM_mosi_m__0__HSIOM_UART_RX EQU 9
SPIM_mosi_m__0__INTCFG EQU CYREG_GPIO_PRT3_INTR_CFG
SPIM_mosi_m__0__INTR EQU CYREG_GPIO_PRT3_INTR
SPIM_mosi_m__0__INTR_CFG EQU CYREG_GPIO_PRT3_INTR_CFG
SPIM_mosi_m__0__INTSTAT EQU CYREG_GPIO_PRT3_INTR
SPIM_mosi_m__0__MASK EQU 0x01
SPIM_mosi_m__0__PC EQU CYREG_GPIO_PRT3_PC
SPIM_mosi_m__0__PC2 EQU CYREG_GPIO_PRT3_PC2
SPIM_mosi_m__0__PORT EQU 3
SPIM_mosi_m__0__PS EQU CYREG_GPIO_PRT3_PS
SPIM_mosi_m__0__SHIFT EQU 0
SPIM_mosi_m__DR EQU CYREG_GPIO_PRT3_DR
SPIM_mosi_m__DR_CLR EQU CYREG_GPIO_PRT3_DR_CLR
SPIM_mosi_m__DR_INV EQU CYREG_GPIO_PRT3_DR_INV
SPIM_mosi_m__DR_SET EQU CYREG_GPIO_PRT3_DR_SET
SPIM_mosi_m__INTCFG EQU CYREG_GPIO_PRT3_INTR_CFG
SPIM_mosi_m__INTR EQU CYREG_GPIO_PRT3_INTR
SPIM_mosi_m__INTR_CFG EQU CYREG_GPIO_PRT3_INTR_CFG
SPIM_mosi_m__INTSTAT EQU CYREG_GPIO_PRT3_INTR
SPIM_mosi_m__MASK EQU 0x01
SPIM_mosi_m__PC EQU CYREG_GPIO_PRT3_PC
SPIM_mosi_m__PC2 EQU CYREG_GPIO_PRT3_PC2
SPIM_mosi_m__PORT EQU 3
SPIM_mosi_m__PS EQU CYREG_GPIO_PRT3_PS
SPIM_mosi_m__SHIFT EQU 0

; SPIM_SCB
SPIM_SCB__CTRL EQU CYREG_SCB1_CTRL
SPIM_SCB__EZ_DATA0 EQU CYREG_SCB1_EZ_DATA0
SPIM_SCB__EZ_DATA1 EQU CYREG_SCB1_EZ_DATA1
SPIM_SCB__EZ_DATA10 EQU CYREG_SCB1_EZ_DATA10
SPIM_SCB__EZ_DATA11 EQU CYREG_SCB1_EZ_DATA11
SPIM_SCB__EZ_DATA12 EQU CYREG_SCB1_EZ_DATA12
SPIM_SCB__EZ_DATA13 EQU CYREG_SCB1_EZ_DATA13
SPIM_SCB__EZ_DATA14 EQU CYREG_SCB1_EZ_DATA14
SPIM_SCB__EZ_DATA15 EQU CYREG_SCB1_EZ_DATA15
SPIM_SCB__EZ_DATA16 EQU CYREG_SCB1_EZ_DATA16
SPIM_SCB__EZ_DATA17 EQU CYREG_SCB1_EZ_DATA17
SPIM_SCB__EZ_DATA18 EQU CYREG_SCB1_EZ_DATA18
SPIM_SCB__EZ_DATA19 EQU CYREG_SCB1_EZ_DATA19
SPIM_SCB__EZ_DATA2 EQU CYREG_SCB1_EZ_DATA2
SPIM_SCB__EZ_DATA20 EQU CYREG_SCB1_EZ_DATA20
SPIM_SCB__EZ_DATA21 EQU CYREG_SCB1_EZ_DATA21
SPIM_SCB__EZ_DATA22 EQU CYREG_SCB1_EZ_DATA22
SPIM_SCB__EZ_DATA23 EQU CYREG_SCB1_EZ_DATA23
SPIM_SCB__EZ_DATA24 EQU CYREG_SCB1_EZ_DATA24
SPIM_SCB__EZ_DATA25 EQU CYREG_SCB1_EZ_DATA25
SPIM_SCB__EZ_DATA26 EQU CYREG_SCB1_EZ_DATA26
SPIM_SCB__EZ_DATA27 EQU CYREG_SCB1_EZ_DATA27
SPIM_SCB__EZ_DATA28 EQU CYREG_SCB1_EZ_DATA28
SPIM_SCB__EZ_DATA29 EQU CYREG_SCB1_EZ_DATA29
SPIM_SCB__EZ_DATA3 EQU CYREG_SCB1_EZ_DATA3
SPIM_SCB__EZ_DATA30 EQU CYREG_SCB1_EZ_DATA30
SPIM_SCB__EZ_DATA31 EQU CYREG_SCB1_EZ_DATA31
SPIM_SCB__EZ_DATA4 EQU CYREG_SCB1_EZ_DATA4
SPIM_SCB__EZ_DATA5 EQU CYREG_SCB1_EZ_DATA5
SPIM_SCB__EZ_DATA6 EQU CYREG_SCB1_EZ_DATA6
SPIM_SCB__EZ_DATA7 EQU CYREG_SCB1_EZ_DATA7
SPIM_SCB__EZ_DATA8 EQU CYREG_SCB1_EZ_DATA8
SPIM_SCB__EZ_DATA9 EQU CYREG_SCB1_EZ_DATA9
SPIM_SCB__I2C_CFG EQU CYREG_SCB1_I2C_CFG
SPIM_SCB__I2C_CTRL EQU CYREG_SCB1_I2C_CTRL
SPIM_SCB__I2C_M_CMD EQU CYREG_SCB1_I2C_M_CMD
SPIM_SCB__I2C_S_CMD EQU CYREG_SCB1_I2C_S_CMD
SPIM_SCB__I2C_STATUS EQU CYREG_SCB1_I2C_STATUS
SPIM_SCB__INTR_CAUSE EQU CYREG_SCB1_INTR_CAUSE
SPIM_SCB__INTR_I2C_EC EQU CYREG_SCB1_INTR_I2C_EC
SPIM_SCB__INTR_I2C_EC_MASK EQU CYREG_SCB1_INTR_I2C_EC_MASK
SPIM_SCB__INTR_I2C_EC_MASKED EQU CYREG_SCB1_INTR_I2C_EC_MASKED
SPIM_SCB__INTR_M EQU CYREG_SCB1_INTR_M
SPIM_SCB__INTR_M_MASK EQU CYREG_SCB1_INTR_M_MASK
SPIM_SCB__INTR_M_MASKED EQU CYREG_SCB1_INTR_M_MASKED
SPIM_SCB__INTR_M_SET EQU CYREG_SCB1_INTR_M_SET
SPIM_SCB__INTR_RX EQU CYREG_SCB1_INTR_RX
SPIM_SCB__INTR_RX_MASK EQU CYREG_SCB1_INTR_RX_MASK
SPIM_SCB__INTR_RX_MASKED EQU CYREG_SCB1_INTR_RX_MASKED
SPIM_SCB__INTR_RX_SET EQU CYREG_SCB1_INTR_RX_SET
SPIM_SCB__INTR_S EQU CYREG_SCB1_INTR_S
SPIM_SCB__INTR_S_MASK EQU CYREG_SCB1_INTR_S_MASK
SPIM_SCB__INTR_S_MASKED EQU CYREG_SCB1_INTR_S_MASKED
SPIM_SCB__INTR_S_SET EQU CYREG_SCB1_INTR_S_SET
SPIM_SCB__INTR_SPI_EC EQU CYREG_SCB1_INTR_SPI_EC
SPIM_SCB__INTR_SPI_EC_MASK EQU CYREG_SCB1_INTR_SPI_EC_MASK
SPIM_SCB__INTR_SPI_EC_MASKED EQU CYREG_SCB1_INTR_SPI_EC_MASKED
SPIM_SCB__INTR_TX EQU CYREG_SCB1_INTR_TX
SPIM_SCB__INTR_TX_MASK EQU CYREG_SCB1_INTR_TX_MASK
SPIM_SCB__INTR_TX_MASKED EQU CYREG_SCB1_INTR_TX_MASKED
SPIM_SCB__INTR_TX_SET EQU CYREG_SCB1_INTR_TX_SET
SPIM_SCB__RX_CTRL EQU CYREG_SCB1_RX_CTRL
SPIM_SCB__RX_FIFO_CTRL EQU CYREG_SCB1_RX_FIFO_CTRL
SPIM_SCB__RX_FIFO_RD EQU CYREG_SCB1_RX_FIFO_RD
SPIM_SCB__RX_FIFO_RD_SILENT EQU CYREG_SCB1_RX_FIFO_RD_SILENT
SPIM_SCB__RX_FIFO_STATUS EQU CYREG_SCB1_RX_FIFO_STATUS
SPIM_SCB__RX_MATCH EQU CYREG_SCB1_RX_MATCH
SPIM_SCB__SPI_CTRL EQU CYREG_SCB1_SPI_CTRL
SPIM_SCB__SPI_STATUS EQU CYREG_SCB1_SPI_STATUS
SPIM_SCB__SS0_POSISTION EQU 0
SPIM_SCB__SS1_POSISTION EQU 1
SPIM_SCB__SS2_POSISTION EQU 2
SPIM_SCB__SS3_POSISTION EQU 3
SPIM_SCB__STATUS EQU CYREG_SCB1_STATUS
SPIM_SCB__TX_CTRL EQU CYREG_SCB1_TX_CTRL
SPIM_SCB__TX_FIFO_CTRL EQU CYREG_SCB1_TX_FIFO_CTRL
SPIM_SCB__TX_FIFO_STATUS EQU CYREG_SCB1_TX_FIFO_STATUS
SPIM_SCB__TX_FIFO_WR EQU CYREG_SCB1_TX_FIFO_WR
SPIM_SCB__UART_CTRL EQU CYREG_SCB1_UART_CTRL
SPIM_SCB__UART_FLOW_CTRL EQU CYREG_SCB1_UART_FLOW_CTRL
SPIM_SCB__UART_RX_CTRL EQU CYREG_SCB1_UART_RX_CTRL
SPIM_SCB__UART_RX_STATUS EQU CYREG_SCB1_UART_RX_STATUS
SPIM_SCB__UART_TX_CTRL EQU CYREG_SCB1_UART_TX_CTRL

; SPIM_SCB_IRQ
SPIM_SCB_IRQ__INTC_CLR_EN_REG EQU CYREG_CM0P_ICER
SPIM_SCB_IRQ__INTC_CLR_PD_REG EQU CYREG_CM0P_ICPR
SPIM_SCB_IRQ__INTC_MASK EQU 0x100
SPIM_SCB_IRQ__INTC_NUMBER EQU 8
SPIM_SCB_IRQ__INTC_PRIOR_MASK EQU 0xC0
SPIM_SCB_IRQ__INTC_PRIOR_NUM EQU 3
SPIM_SCB_IRQ__INTC_PRIOR_REG EQU CYREG_CM0P_IPR2
SPIM_SCB_IRQ__INTC_SET_EN_REG EQU CYREG_CM0P_ISER
SPIM_SCB_IRQ__INTC_SET_PD_REG EQU CYREG_CM0P_ISPR

; SPIM_SCBCLK
SPIM_SCBCLK__CTRL_REGISTER EQU CYREG_PERI_PCLK_CTL1
SPIM_SCBCLK__DIV_ID EQU 0x00000041
SPIM_SCBCLK__DIV_REGISTER EQU CYREG_PERI_DIV_16_CTL1
SPIM_SCBCLK__PA_DIV_ID EQU 0x000000FF

; SPIM_sclk_m
SPIM_sclk_m__0__DR EQU CYREG_GPIO_PRT0_DR
SPIM_sclk_m__0__DR_CLR EQU CYREG_GPIO_PRT0_DR_CLR
SPIM_sclk_m__0__DR_INV EQU CYREG_GPIO_PRT0_DR_INV
SPIM_sclk_m__0__DR_SET EQU CYREG_GPIO_PRT0_DR_SET
SPIM_sclk_m__0__HSIOM EQU CYREG_HSIOM_PORT_SEL0
SPIM_sclk_m__0__HSIOM_GPIO EQU 0
SPIM_sclk_m__0__HSIOM_MASK EQU 0x0F000000
SPIM_sclk_m__0__HSIOM_SHIFT EQU 24
SPIM_sclk_m__0__HSIOM_SPI EQU 15
SPIM_sclk_m__0__HSIOM_SPI_CLK EQU 15
SPIM_sclk_m__0__HSIOM_UART EQU 9
SPIM_sclk_m__0__HSIOM_UART_CTS EQU 9
SPIM_sclk_m__0__INTCFG EQU CYREG_GPIO_PRT0_INTR_CFG
SPIM_sclk_m__0__INTR EQU CYREG_GPIO_PRT0_INTR
SPIM_sclk_m__0__INTR_CFG EQU CYREG_GPIO_PRT0_INTR_CFG
SPIM_sclk_m__0__INTSTAT EQU CYREG_GPIO_PRT0_INTR
SPIM_sclk_m__0__MASK EQU 0x40
SPIM_sclk_m__0__PC EQU CYREG_GPIO_PRT0_PC
SPIM_sclk_m__0__PC2 EQU CYREG_GPIO_PRT0_PC2
SPIM_sclk_m__0__PORT EQU 0
SPIM_sclk_m__0__PS EQU CYREG_GPIO_PRT0_PS
SPIM_sclk_m__0__SHIFT EQU 6
SPIM_sclk_m__DR EQU CYREG_GPIO_PRT0_DR
SPIM_sclk_m__DR_CLR EQU CYREG_GPIO_PRT0_DR_CLR
SPIM_sclk_m__DR_INV EQU CYREG_GPIO_PRT0_DR_INV
SPIM_sclk_m__DR_SET EQU CYREG_GPIO_PRT0_DR_SET
SPIM_sclk_m__INTCFG EQU CYREG_GPIO_PRT0_INTR_CFG
SPIM_sclk_m__INTR EQU CYREG_GPIO_PRT0_INTR
SPIM_sclk_m__INTR_CFG EQU CYREG_GPIO_PRT0_INTR_CFG
SPIM_sclk_m__INTSTAT EQU CYREG_GPIO_PRT0_INTR
SPIM_sclk_m__MASK EQU 0x40
SPIM_sclk_m__PC EQU CYREG_GPIO_PRT0_PC
SPIM_sclk_m__PC2 EQU CYREG_GPIO_PRT0_PC2
SPIM_sclk_m__PORT EQU 0
SPIM_sclk_m__PS EQU CYREG_GPIO_PRT0_PS
SPIM_sclk_m__SHIFT EQU 6

; Blank
Blank__0__DR EQU CYREG_GPIO_PRT2_DR
Blank__0__DR_CLR EQU CYREG_GPIO_PRT2_DR_CLR
Blank__0__DR_INV EQU CYREG_GPIO_PRT2_DR_INV
Blank__0__DR_SET EQU CYREG_GPIO_PRT2_DR_SET
Blank__0__HSIOM EQU CYREG_HSIOM_PORT_SEL2
Blank__0__HSIOM_MASK EQU 0x0F000000
Blank__0__HSIOM_SHIFT EQU 24
Blank__0__INTCFG EQU CYREG_GPIO_PRT2_INTR_CFG
Blank__0__INTR EQU CYREG_GPIO_PRT2_INTR
Blank__0__INTR_CFG EQU CYREG_GPIO_PRT2_INTR_CFG
Blank__0__INTSTAT EQU CYREG_GPIO_PRT2_INTR
Blank__0__MASK EQU 0x40
Blank__0__PC EQU CYREG_GPIO_PRT2_PC
Blank__0__PC2 EQU CYREG_GPIO_PRT2_PC2
Blank__0__PORT EQU 2
Blank__0__PS EQU CYREG_GPIO_PRT2_PS
Blank__0__SHIFT EQU 6
Blank__DR EQU CYREG_GPIO_PRT2_DR
Blank__DR_CLR EQU CYREG_GPIO_PRT2_DR_CLR
Blank__DR_INV EQU CYREG_GPIO_PRT2_DR_INV
Blank__DR_SET EQU CYREG_GPIO_PRT2_DR_SET
Blank__INTCFG EQU CYREG_GPIO_PRT2_INTR_CFG
Blank__INTR EQU CYREG_GPIO_PRT2_INTR
Blank__INTR_CFG EQU CYREG_GPIO_PRT2_INTR_CFG
Blank__INTSTAT EQU CYREG_GPIO_PRT2_INTR
Blank__MASK EQU 0x40
Blank__PC EQU CYREG_GPIO_PRT2_PC
Blank__PC2 EQU CYREG_GPIO_PRT2_PC2
Blank__PORT EQU 2
Blank__PS EQU CYREG_GPIO_PRT2_PS
Blank__SHIFT EQU 6

; Latch
Latch__0__DR EQU CYREG_GPIO_PRT2_DR
Latch__0__DR_CLR EQU CYREG_GPIO_PRT2_DR_CLR
Latch__0__DR_INV EQU CYREG_GPIO_PRT2_DR_INV
Latch__0__DR_SET EQU CYREG_GPIO_PRT2_DR_SET
Latch__0__HSIOM EQU CYREG_HSIOM_PORT_SEL2
Latch__0__HSIOM_MASK EQU 0xF0000000
Latch__0__HSIOM_SHIFT EQU 28
Latch__0__INTCFG EQU CYREG_GPIO_PRT2_INTR_CFG
Latch__0__INTR EQU CYREG_GPIO_PRT2_INTR
Latch__0__INTR_CFG EQU CYREG_GPIO_PRT2_INTR_CFG
Latch__0__INTSTAT EQU CYREG_GPIO_PRT2_INTR
Latch__0__MASK EQU 0x80
Latch__0__PC EQU CYREG_GPIO_PRT2_PC
Latch__0__PC2 EQU CYREG_GPIO_PRT2_PC2
Latch__0__PORT EQU 2
Latch__0__PS EQU CYREG_GPIO_PRT2_PS
Latch__0__SHIFT EQU 7
Latch__DR EQU CYREG_GPIO_PRT2_DR
Latch__DR_CLR EQU CYREG_GPIO_PRT2_DR_CLR
Latch__DR_INV EQU CYREG_GPIO_PRT2_DR_INV
Latch__DR_SET EQU CYREG_GPIO_PRT2_DR_SET
Latch__INTCFG EQU CYREG_GPIO_PRT2_INTR_CFG
Latch__INTR EQU CYREG_GPIO_PRT2_INTR
Latch__INTR_CFG EQU CYREG_GPIO_PRT2_INTR_CFG
Latch__INTSTAT EQU CYREG_GPIO_PRT2_INTR
Latch__MASK EQU 0x80
Latch__PC EQU CYREG_GPIO_PRT2_PC
Latch__PC2 EQU CYREG_GPIO_PRT2_PC2
Latch__PORT EQU 2
Latch__PS EQU CYREG_GPIO_PRT2_PS
Latch__SHIFT EQU 7

; CAPINT
CAPINT__0__DR EQU CYREG_GPIO_PRT4_DR
CAPINT__0__DR_CLR EQU CYREG_GPIO_PRT4_DR_CLR
CAPINT__0__DR_INV EQU CYREG_GPIO_PRT4_DR_INV
CAPINT__0__DR_SET EQU CYREG_GPIO_PRT4_DR_SET
CAPINT__0__HSIOM EQU CYREG_HSIOM_PORT_SEL4
CAPINT__0__HSIOM_MASK EQU 0x00000F00
CAPINT__0__HSIOM_SHIFT EQU 8
CAPINT__0__INTCFG EQU CYREG_GPIO_PRT4_INTR_CFG
CAPINT__0__INTR EQU CYREG_GPIO_PRT4_INTR
CAPINT__0__INTR_CFG EQU CYREG_GPIO_PRT4_INTR_CFG
CAPINT__0__INTSTAT EQU CYREG_GPIO_PRT4_INTR
CAPINT__0__MASK EQU 0x04
CAPINT__0__PC EQU CYREG_GPIO_PRT4_PC
CAPINT__0__PC2 EQU CYREG_GPIO_PRT4_PC2
CAPINT__0__PORT EQU 4
CAPINT__0__PS EQU CYREG_GPIO_PRT4_PS
CAPINT__0__SHIFT EQU 2
CAPINT__DR EQU CYREG_GPIO_PRT4_DR
CAPINT__DR_CLR EQU CYREG_GPIO_PRT4_DR_CLR
CAPINT__DR_INV EQU CYREG_GPIO_PRT4_DR_INV
CAPINT__DR_SET EQU CYREG_GPIO_PRT4_DR_SET
CAPINT__INTCFG EQU CYREG_GPIO_PRT4_INTR_CFG
CAPINT__INTR EQU CYREG_GPIO_PRT4_INTR
CAPINT__INTR_CFG EQU CYREG_GPIO_PRT4_INTR_CFG
CAPINT__INTSTAT EQU CYREG_GPIO_PRT4_INTR
CAPINT__MASK EQU 0x04
CAPINT__PC EQU CYREG_GPIO_PRT4_PC
CAPINT__PC2 EQU CYREG_GPIO_PRT4_PC2
CAPINT__PORT EQU 4
CAPINT__PS EQU CYREG_GPIO_PRT4_PS
CAPINT__SHIFT EQU 2

; Clock_1
Clock_1__CTRL_REGISTER EQU CYREG_PERI_PCLK_CTL3
Clock_1__DIV_ID EQU 0x00000042
Clock_1__DIV_REGISTER EQU CYREG_PERI_DIV_16_CTL2
Clock_1__PA_DIV_ID EQU 0x000000FF

; Timer_1_cy_m0s8_tcpwm_1
Timer_1_cy_m0s8_tcpwm_1__CC EQU CYREG_TCPWM_CNT0_CC
Timer_1_cy_m0s8_tcpwm_1__CC_BUFF EQU CYREG_TCPWM_CNT0_CC_BUFF
Timer_1_cy_m0s8_tcpwm_1__COUNTER EQU CYREG_TCPWM_CNT0_COUNTER
Timer_1_cy_m0s8_tcpwm_1__CTRL EQU CYREG_TCPWM_CNT0_CTRL
Timer_1_cy_m0s8_tcpwm_1__INTR EQU CYREG_TCPWM_CNT0_INTR
Timer_1_cy_m0s8_tcpwm_1__INTR_MASK EQU CYREG_TCPWM_CNT0_INTR_MASK
Timer_1_cy_m0s8_tcpwm_1__INTR_MASKED EQU CYREG_TCPWM_CNT0_INTR_MASKED
Timer_1_cy_m0s8_tcpwm_1__INTR_SET EQU CYREG_TCPWM_CNT0_INTR_SET
Timer_1_cy_m0s8_tcpwm_1__PERIOD EQU CYREG_TCPWM_CNT0_PERIOD
Timer_1_cy_m0s8_tcpwm_1__PERIOD_BUFF EQU CYREG_TCPWM_CNT0_PERIOD_BUFF
Timer_1_cy_m0s8_tcpwm_1__STATUS EQU CYREG_TCPWM_CNT0_STATUS
Timer_1_cy_m0s8_tcpwm_1__TCPWM_CMD EQU CYREG_TCPWM_CMD
Timer_1_cy_m0s8_tcpwm_1__TCPWM_CMDCAPTURE_MASK EQU 0x01
Timer_1_cy_m0s8_tcpwm_1__TCPWM_CMDCAPTURE_SHIFT EQU 0
Timer_1_cy_m0s8_tcpwm_1__TCPWM_CMDRELOAD_MASK EQU 0x100
Timer_1_cy_m0s8_tcpwm_1__TCPWM_CMDRELOAD_SHIFT EQU 8
Timer_1_cy_m0s8_tcpwm_1__TCPWM_CMDSTART_MASK EQU 0x1000000
Timer_1_cy_m0s8_tcpwm_1__TCPWM_CMDSTART_SHIFT EQU 24
Timer_1_cy_m0s8_tcpwm_1__TCPWM_CMDSTOP_MASK EQU 0x10000
Timer_1_cy_m0s8_tcpwm_1__TCPWM_CMDSTOP_SHIFT EQU 16
Timer_1_cy_m0s8_tcpwm_1__TCPWM_CTRL EQU CYREG_TCPWM_CTRL
Timer_1_cy_m0s8_tcpwm_1__TCPWM_CTRL_MASK EQU 0x01
Timer_1_cy_m0s8_tcpwm_1__TCPWM_CTRL_SHIFT EQU 0
Timer_1_cy_m0s8_tcpwm_1__TCPWM_INTR_CAUSE EQU CYREG_TCPWM_INTR_CAUSE
Timer_1_cy_m0s8_tcpwm_1__TCPWM_INTR_CAUSE_MASK EQU 0x01
Timer_1_cy_m0s8_tcpwm_1__TCPWM_INTR_CAUSE_SHIFT EQU 0
Timer_1_cy_m0s8_tcpwm_1__TCPWM_NUMBER EQU 0
Timer_1_cy_m0s8_tcpwm_1__TR_CTRL0 EQU CYREG_TCPWM_CNT0_TR_CTRL0
Timer_1_cy_m0s8_tcpwm_1__TR_CTRL1 EQU CYREG_TCPWM_CNT0_TR_CTRL1
Timer_1_cy_m0s8_tcpwm_1__TR_CTRL2 EQU CYREG_TCPWM_CNT0_TR_CTRL2

; CapSense_Cmod
CapSense_Cmod__0__DR EQU CYREG_GPIO_PRT4_DR
CapSense_Cmod__0__DR_CLR EQU CYREG_GPIO_PRT4_DR_CLR
CapSense_Cmod__0__DR_INV EQU CYREG_GPIO_PRT4_DR_INV
CapSense_Cmod__0__DR_SET EQU CYREG_GPIO_PRT4_DR_SET
CapSense_Cmod__0__HSIOM EQU CYREG_HSIOM_PORT_SEL4
CapSense_Cmod__0__HSIOM_MASK EQU 0x0000F000
CapSense_Cmod__0__HSIOM_SHIFT EQU 12
CapSense_Cmod__0__INTCFG EQU CYREG_GPIO_PRT4_INTR_CFG
CapSense_Cmod__0__INTR EQU CYREG_GPIO_PRT4_INTR
CapSense_Cmod__0__INTR_CFG EQU CYREG_GPIO_PRT4_INTR_CFG
CapSense_Cmod__0__INTSTAT EQU CYREG_GPIO_PRT4_INTR
CapSense_Cmod__0__MASK EQU 0x08
CapSense_Cmod__0__PC EQU CYREG_GPIO_PRT4_PC
CapSense_Cmod__0__PC2 EQU CYREG_GPIO_PRT4_PC2
CapSense_Cmod__0__PORT EQU 4
CapSense_Cmod__0__PS EQU CYREG_GPIO_PRT4_PS
CapSense_Cmod__0__SHIFT EQU 3
CapSense_Cmod__Cmod__DR EQU CYREG_GPIO_PRT4_DR
CapSense_Cmod__Cmod__DR_CLR EQU CYREG_GPIO_PRT4_DR_CLR
CapSense_Cmod__Cmod__DR_INV EQU CYREG_GPIO_PRT4_DR_INV
CapSense_Cmod__Cmod__DR_SET EQU CYREG_GPIO_PRT4_DR_SET
CapSense_Cmod__Cmod__INTCFG EQU CYREG_GPIO_PRT4_INTR_CFG
CapSense_Cmod__Cmod__INTR EQU CYREG_GPIO_PRT4_INTR
CapSense_Cmod__Cmod__INTR_CFG EQU CYREG_GPIO_PRT4_INTR_CFG
CapSense_Cmod__Cmod__INTSTAT EQU CYREG_GPIO_PRT4_INTR
CapSense_Cmod__Cmod__MASK EQU 0x08
CapSense_Cmod__Cmod__PC EQU CYREG_GPIO_PRT4_PC
CapSense_Cmod__Cmod__PC2 EQU CYREG_GPIO_PRT4_PC2
CapSense_Cmod__Cmod__PORT EQU 4
CapSense_Cmod__Cmod__PS EQU CYREG_GPIO_PRT4_PS
CapSense_Cmod__Cmod__SHIFT EQU 3
CapSense_Cmod__DR EQU CYREG_GPIO_PRT4_DR
CapSense_Cmod__DR_CLR EQU CYREG_GPIO_PRT4_DR_CLR
CapSense_Cmod__DR_INV EQU CYREG_GPIO_PRT4_DR_INV
CapSense_Cmod__DR_SET EQU CYREG_GPIO_PRT4_DR_SET
CapSense_Cmod__INTCFG EQU CYREG_GPIO_PRT4_INTR_CFG
CapSense_Cmod__INTR EQU CYREG_GPIO_PRT4_INTR
CapSense_Cmod__INTR_CFG EQU CYREG_GPIO_PRT4_INTR_CFG
CapSense_Cmod__INTSTAT EQU CYREG_GPIO_PRT4_INTR
CapSense_Cmod__MASK EQU 0x08
CapSense_Cmod__PC EQU CYREG_GPIO_PRT4_PC
CapSense_Cmod__PC2 EQU CYREG_GPIO_PRT4_PC2
CapSense_Cmod__PORT EQU 4
CapSense_Cmod__PS EQU CYREG_GPIO_PRT4_PS
CapSense_Cmod__SHIFT EQU 3

; CapSense_CSD
CapSense_CSD__ADC_CTL EQU CYREG_CSD_ADC_CTL
CapSense_CSD__CMOD_PAD EQU 1
CapSense_CSD__CSD_CONFIG EQU CYREG_CSD_CONFIG
CapSense_CSD__CSD_INTR EQU CYREG_CSD_INTR
CapSense_CSD__CSD_INTR_SET EQU CYREG_CSD_INTR_SET
CapSense_CSD__CSD_NUMBER EQU 0
CapSense_CSD__CSD_STATUS EQU CYREG_CSD_STATUS
CapSense_CSD__CSDCMP EQU CYREG_CSD_CSDCMP
CapSense_CSD__CSH_TANK_PAD EQU 2
CapSense_CSD__CSHIELD_PAD EQU 4
CapSense_CSD__DEDICATED_IO EQU CapSense_CSD__CSH_TANK_PAD
CapSense_CSD__HSCMP EQU CYREG_CSD_HSCMP
CapSense_CSD__INTR_MASK EQU CYREG_CSD_INTR_MASK
CapSense_CSD__REFGEN EQU CYREG_CSD_REFGEN
CapSense_CSD__RESULT_VAL1 EQU CYREG_CSD_RESULT_VAL1
CapSense_CSD__RESULT_VAL2 EQU CYREG_CSD_RESULT_VAL2
CapSense_CSD__SENSE_DUTY EQU CYREG_CSD_SENSE_DUTY
CapSense_CSD__SENSE_PERIOD EQU CYREG_CSD_SENSE_PERIOD
CapSense_CSD__SEQ_INIT_CNT EQU CYREG_CSD_SEQ_INIT_CNT
CapSense_CSD__SEQ_NORM_CNT EQU CYREG_CSD_SEQ_NORM_CNT
CapSense_CSD__SEQ_START EQU CYREG_CSD_SEQ_START
CapSense_CSD__SEQ_TIME EQU CYREG_CSD_SEQ_TIME
CapSense_CSD__SW_AMUXBUF_SEL EQU CYREG_CSD_SW_AMUXBUF_SEL
CapSense_CSD__SW_BYP_SEL EQU CYREG_CSD_SW_BYP_SEL
CapSense_CSD__SW_CMP_N_SEL EQU CYREG_CSD_SW_CMP_N_SEL
CapSense_CSD__SW_CMP_P_SEL EQU CYREG_CSD_SW_CMP_P_SEL
CapSense_CSD__SW_DSI_SEL EQU CYREG_CSD_SW_DSI_SEL
CapSense_CSD__SW_FW_MOD_SEL EQU CYREG_CSD_SW_FW_MOD_SEL
CapSense_CSD__SW_FW_TANK_SEL EQU CYREG_CSD_SW_FW_TANK_SEL
CapSense_CSD__SW_HS_N_SEL EQU CYREG_CSD_SW_HS_N_SEL
CapSense_CSD__SW_HS_P_SEL EQU CYREG_CSD_SW_HS_P_SEL
CapSense_CSD__SW_REFGEN_SEL EQU CYREG_CSD_SW_REFGEN_SEL
CapSense_CSD__SW_RES EQU CYREG_CSD_SW_RES
CapSense_CSD__SW_SHIELD_SEL EQU CYREG_CSD_SW_SHIELD_SEL

; CapSense_IDACComp
CapSense_IDACComp__CONFIG EQU CYREG_CSD_CONFIG
CapSense_IDACComp__IDAC EQU CYREG_CSD_IDACB
CapSense_IDACComp__POSITION EQU 1

; CapSense_IDACMod
CapSense_IDACMod__CONFIG EQU CYREG_CSD_CONFIG
CapSense_IDACMod__IDAC EQU CYREG_CSD_IDACA
CapSense_IDACMod__POSITION EQU 0

; CapSense_ISR
CapSense_ISR__INTC_CLR_EN_REG EQU CYREG_CM0P_ICER
CapSense_ISR__INTC_CLR_PD_REG EQU CYREG_CM0P_ICPR
CapSense_ISR__INTC_MASK EQU 0x400
CapSense_ISR__INTC_NUMBER EQU 10
CapSense_ISR__INTC_PRIOR_MASK EQU 0xC00000
CapSense_ISR__INTC_PRIOR_NUM EQU 3
CapSense_ISR__INTC_PRIOR_REG EQU CYREG_CM0P_IPR2
CapSense_ISR__INTC_SET_EN_REG EQU CYREG_CM0P_ISER
CapSense_ISR__INTC_SET_PD_REG EQU CYREG_CM0P_ISPR

; CapSense_ModClk
CapSense_ModClk__CTRL_REGISTER EQU CYREG_PERI_PCLK_CTL2
CapSense_ModClk__DIV_ID EQU 0x00000040
CapSense_ModClk__DIV_REGISTER EQU CYREG_PERI_DIV_16_CTL0
CapSense_ModClk__PA_DIV_ID EQU 0x000000FF

; CapSense_Sns
CapSense_Sns__0__DR EQU CYREG_GPIO_PRT0_DR
CapSense_Sns__0__DR_CLR EQU CYREG_GPIO_PRT0_DR_CLR
CapSense_Sns__0__DR_INV EQU CYREG_GPIO_PRT0_DR_INV
CapSense_Sns__0__DR_SET EQU CYREG_GPIO_PRT0_DR_SET
CapSense_Sns__0__HSIOM EQU CYREG_HSIOM_PORT_SEL0
CapSense_Sns__0__HSIOM_MASK EQU 0x0000000F
CapSense_Sns__0__HSIOM_SHIFT EQU 0
CapSense_Sns__0__INTCFG EQU CYREG_GPIO_PRT0_INTR_CFG
CapSense_Sns__0__INTR EQU CYREG_GPIO_PRT0_INTR
CapSense_Sns__0__INTR_CFG EQU CYREG_GPIO_PRT0_INTR_CFG
CapSense_Sns__0__INTSTAT EQU CYREG_GPIO_PRT0_INTR
CapSense_Sns__0__MASK EQU 0x01
CapSense_Sns__0__PC EQU CYREG_GPIO_PRT0_PC
CapSense_Sns__0__PC2 EQU CYREG_GPIO_PRT0_PC2
CapSense_Sns__0__PORT EQU 0
CapSense_Sns__0__PS EQU CYREG_GPIO_PRT0_PS
CapSense_Sns__0__SHIFT EQU 0
CapSense_Sns__BUT0_Sns0__DR EQU CYREG_GPIO_PRT0_DR
CapSense_Sns__BUT0_Sns0__DR_CLR EQU CYREG_GPIO_PRT0_DR_CLR
CapSense_Sns__BUT0_Sns0__DR_INV EQU CYREG_GPIO_PRT0_DR_INV
CapSense_Sns__BUT0_Sns0__DR_SET EQU CYREG_GPIO_PRT0_DR_SET
CapSense_Sns__BUT0_Sns0__INTCFG EQU CYREG_GPIO_PRT0_INTR_CFG
CapSense_Sns__BUT0_Sns0__INTR EQU CYREG_GPIO_PRT0_INTR
CapSense_Sns__BUT0_Sns0__INTR_CFG EQU CYREG_GPIO_PRT0_INTR_CFG
CapSense_Sns__BUT0_Sns0__INTSTAT EQU CYREG_GPIO_PRT0_INTR
CapSense_Sns__BUT0_Sns0__MASK EQU 0x01
CapSense_Sns__BUT0_Sns0__PC EQU CYREG_GPIO_PRT0_PC
CapSense_Sns__BUT0_Sns0__PC2 EQU CYREG_GPIO_PRT0_PC2
CapSense_Sns__BUT0_Sns0__PORT EQU 0
CapSense_Sns__BUT0_Sns0__PS EQU CYREG_GPIO_PRT0_PS
CapSense_Sns__BUT0_Sns0__SHIFT EQU 0
CapSense_Sns__DR EQU CYREG_GPIO_PRT0_DR
CapSense_Sns__DR_CLR EQU CYREG_GPIO_PRT0_DR_CLR
CapSense_Sns__DR_INV EQU CYREG_GPIO_PRT0_DR_INV
CapSense_Sns__DR_SET EQU CYREG_GPIO_PRT0_DR_SET
CapSense_Sns__INTCFG EQU CYREG_GPIO_PRT0_INTR_CFG
CapSense_Sns__INTR EQU CYREG_GPIO_PRT0_INTR
CapSense_Sns__INTR_CFG EQU CYREG_GPIO_PRT0_INTR_CFG
CapSense_Sns__INTSTAT EQU CYREG_GPIO_PRT0_INTR
CapSense_Sns__MASK EQU 0x01
CapSense_Sns__PC EQU CYREG_GPIO_PRT0_PC
CapSense_Sns__PC2 EQU CYREG_GPIO_PRT0_PC2
CapSense_Sns__PORT EQU 0
CapSense_Sns__PS EQU CYREG_GPIO_PRT0_PS
CapSense_Sns__SHIFT EQU 0

; TimerISR
TimerISR__INTC_CLR_EN_REG EQU CYREG_CM0P_ICER
TimerISR__INTC_CLR_PD_REG EQU CYREG_CM0P_ICPR
TimerISR__INTC_MASK EQU 0x800
TimerISR__INTC_NUMBER EQU 11
TimerISR__INTC_PRIOR_MASK EQU 0xC0000000
TimerISR__INTC_PRIOR_NUM EQU 3
TimerISR__INTC_PRIOR_REG EQU CYREG_CM0P_IPR2
TimerISR__INTC_SET_EN_REG EQU CYREG_CM0P_ISER
TimerISR__INTC_SET_PD_REG EQU CYREG_CM0P_ISPR

; Miscellaneous
CYDEV_BCLK__HFCLK__HZ EQU 24000000
CYDEV_BCLK__HFCLK__KHZ EQU 24000
CYDEV_BCLK__HFCLK__MHZ EQU 24
CYDEV_BCLK__SYSCLK__HZ EQU 24000000
CYDEV_BCLK__SYSCLK__KHZ EQU 24000
CYDEV_BCLK__SYSCLK__MHZ EQU 24
CYDEV_CHIP_DIE_LEOPARD EQU 1
CYDEV_CHIP_DIE_PSOC4A EQU 12
CYDEV_CHIP_DIE_PSOC5LP EQU 19
CYDEV_CHIP_DIE_PSOC5TM EQU 20
CYDEV_CHIP_DIE_TMA4 EQU 2
CYDEV_CHIP_DIE_UNKNOWN EQU 0
CYDEV_CHIP_FAMILY_FM0P EQU 4
CYDEV_CHIP_FAMILY_FM3 EQU 5
CYDEV_CHIP_FAMILY_FM4 EQU 6
CYDEV_CHIP_FAMILY_PSOC3 EQU 1
CYDEV_CHIP_FAMILY_PSOC4 EQU 2
CYDEV_CHIP_FAMILY_PSOC5 EQU 3
CYDEV_CHIP_FAMILY_UNKNOWN EQU 0
CYDEV_CHIP_FAMILY_USED EQU CYDEV_CHIP_FAMILY_PSOC4
CYDEV_CHIP_JTAG_ID EQU 0x190711A9
CYDEV_CHIP_MEMBER_3A EQU 1
CYDEV_CHIP_MEMBER_4A EQU 12
CYDEV_CHIP_MEMBER_4C EQU 18
CYDEV_CHIP_MEMBER_4D EQU 8
CYDEV_CHIP_MEMBER_4E EQU 4
CYDEV_CHIP_MEMBER_4F EQU 13
CYDEV_CHIP_MEMBER_4G EQU 2
CYDEV_CHIP_MEMBER_4H EQU 11
CYDEV_CHIP_MEMBER_4I EQU 17
CYDEV_CHIP_MEMBER_4J EQU 9
CYDEV_CHIP_MEMBER_4K EQU 10
CYDEV_CHIP_MEMBER_4L EQU 16
CYDEV_CHIP_MEMBER_4M EQU 15
CYDEV_CHIP_MEMBER_4N EQU 6
CYDEV_CHIP_MEMBER_4O EQU 5
CYDEV_CHIP_MEMBER_4P EQU 14
CYDEV_CHIP_MEMBER_4Q EQU 7
CYDEV_CHIP_MEMBER_4U EQU 3
CYDEV_CHIP_MEMBER_5A EQU 20
CYDEV_CHIP_MEMBER_5B EQU 19
CYDEV_CHIP_MEMBER_FM3 EQU 24
CYDEV_CHIP_MEMBER_FM4 EQU 25
CYDEV_CHIP_MEMBER_PDL_FM0P_TYPE1 EQU 21
CYDEV_CHIP_MEMBER_PDL_FM0P_TYPE2 EQU 22
CYDEV_CHIP_MEMBER_PDL_FM0P_TYPE3 EQU 23
CYDEV_CHIP_MEMBER_UNKNOWN EQU 0
CYDEV_CHIP_MEMBER_USED EQU CYDEV_CHIP_MEMBER_4J
CYDEV_CHIP_DIE_EXPECT EQU CYDEV_CHIP_MEMBER_USED
CYDEV_CHIP_DIE_ACTUAL EQU CYDEV_CHIP_DIE_EXPECT
CYDEV_CHIP_REV_LEOPARD_ES1 EQU 0
CYDEV_CHIP_REV_LEOPARD_ES2 EQU 1
CYDEV_CHIP_REV_LEOPARD_ES3 EQU 3
CYDEV_CHIP_REV_LEOPARD_PRODUCTION EQU 3
CYDEV_CHIP_REV_PSOC4A_ES0 EQU 17
CYDEV_CHIP_REV_PSOC4A_PRODUCTION EQU 17
CYDEV_CHIP_REV_PSOC5LP_ES0 EQU 0
CYDEV_CHIP_REV_PSOC5LP_PRODUCTION EQU 0
CYDEV_CHIP_REV_PSOC5TM_ES0 EQU 0
CYDEV_CHIP_REV_PSOC5TM_ES1 EQU 1
CYDEV_CHIP_REV_PSOC5TM_PRODUCTION EQU 1
CYDEV_CHIP_REV_TMA4_ES EQU 17
CYDEV_CHIP_REV_TMA4_ES2 EQU 33
CYDEV_CHIP_REV_TMA4_PRODUCTION EQU 17
CYDEV_CHIP_REVISION_3A_ES1 EQU 0
CYDEV_CHIP_REVISION_3A_ES2 EQU 1
CYDEV_CHIP_REVISION_3A_ES3 EQU 3
CYDEV_CHIP_REVISION_3A_PRODUCTION EQU 3
CYDEV_CHIP_REVISION_4A_ES0 EQU 17
CYDEV_CHIP_REVISION_4A_PRODUCTION EQU 17
CYDEV_CHIP_REVISION_4C_PRODUCTION EQU 0
CYDEV_CHIP_REVISION_4D_PRODUCTION EQU 0
CYDEV_CHIP_REVISION_4E_PRODUCTION EQU 0
CYDEV_CHIP_REVISION_4F_PRODUCTION EQU 0
CYDEV_CHIP_REVISION_4F_PRODUCTION_256DMA EQU 0
CYDEV_CHIP_REVISION_4F_PRODUCTION_256K EQU 0
CYDEV_CHIP_REVISION_4G_ES EQU 17
CYDEV_CHIP_REVISION_4G_ES2 EQU 33
CYDEV_CHIP_REVISION_4G_PRODUCTION EQU 17
CYDEV_CHIP_REVISION_4H_PRODUCTION EQU 0
CYDEV_CHIP_REVISION_4I_PRODUCTION EQU 0
CYDEV_CHIP_REVISION_4J_PRODUCTION EQU 0
CYDEV_CHIP_REVISION_4K_PRODUCTION EQU 0
CYDEV_CHIP_REVISION_4L_PRODUCTION EQU 0
CYDEV_CHIP_REVISION_4M_PRODUCTION EQU 0
CYDEV_CHIP_REVISION_4N_PRODUCTION EQU 0
CYDEV_CHIP_REVISION_4O_PRODUCTION EQU 0
CYDEV_CHIP_REVISION_4P_PRODUCTION EQU 0
CYDEV_CHIP_REVISION_4Q_PRODUCTION EQU 0
CYDEV_CHIP_REVISION_4U_PRODUCTION EQU 0
CYDEV_CHIP_REVISION_5A_ES0 EQU 0
CYDEV_CHIP_REVISION_5A_ES1 EQU 1
CYDEV_CHIP_REVISION_5A_PRODUCTION EQU 1
CYDEV_CHIP_REVISION_5B_ES0 EQU 0
CYDEV_CHIP_REVISION_5B_PRODUCTION EQU 0
CYDEV_CHIP_REVISION_FM3_PRODUCTION EQU 0
CYDEV_CHIP_REVISION_FM4_PRODUCTION EQU 0
CYDEV_CHIP_REVISION_PDL_FM0P_TYPE1_PRODUCTION EQU 0
CYDEV_CHIP_REVISION_PDL_FM0P_TYPE2_PRODUCTION EQU 0
CYDEV_CHIP_REVISION_PDL_FM0P_TYPE3_PRODUCTION EQU 0
CYDEV_CHIP_REVISION_USED EQU CYDEV_CHIP_REVISION_4J_PRODUCTION
CYDEV_CHIP_REV_EXPECT EQU CYDEV_CHIP_REVISION_USED
CYDEV_CONFIG_READ_ACCELERATOR EQU 1
CYDEV_CONFIG_UNUSED_IO_AllowButWarn EQU 0
CYDEV_CONFIG_UNUSED_IO EQU CYDEV_CONFIG_UNUSED_IO_AllowButWarn
CYDEV_CONFIG_UNUSED_IO_AllowWithInfo EQU 1
CYDEV_CONFIG_UNUSED_IO_Disallowed EQU 2
CYDEV_CONFIGURATION_COMPRESSED EQU 1
CYDEV_CONFIGURATION_MODE_COMPRESSED EQU 0
CYDEV_CONFIGURATION_MODE EQU CYDEV_CONFIGURATION_MODE_COMPRESSED
CYDEV_CONFIGURATION_MODE_DMA EQU 2
CYDEV_CONFIGURATION_MODE_UNCOMPRESSED EQU 1
CYDEV_DEBUG_PROTECT_KILL EQU 4
CYDEV_DEBUG_PROTECT_OPEN EQU 1
CYDEV_DEBUG_PROTECT EQU CYDEV_DEBUG_PROTECT_OPEN
CYDEV_DEBUG_PROTECT_PROTECTED EQU 2
CYDEV_DEBUGGING_DPS_Disable EQU 3
CYDEV_DEBUGGING_DPS_SWD EQU 2
CYDEV_DEBUGGING_DPS EQU CYDEV_DEBUGGING_DPS_SWD
CYDEV_DEBUGGING_ENABLE EQU 1
CYDEV_DFT_SELECT_CLK0 EQU 8
CYDEV_DFT_SELECT_CLK1 EQU 9
CYDEV_HEAP_SIZE EQU 0xFF
CYDEV_IMO_TRIMMED_BY_USB EQU 0
CYDEV_IMO_TRIMMED_BY_WCO EQU 0
CYDEV_IS_EXPORTING_CODE EQU 0
CYDEV_IS_IMPORTING_CODE EQU 0
CYDEV_PROJ_TYPE EQU 2
CYDEV_PROJ_TYPE_BOOTLOADER EQU 1
CYDEV_PROJ_TYPE_LAUNCHER EQU 5
CYDEV_PROJ_TYPE_LOADABLE EQU 2
CYDEV_PROJ_TYPE_LOADABLEANDBOOTLOADER EQU 4
CYDEV_PROJ_TYPE_MULTIAPPBOOTLOADER EQU 3
CYDEV_PROJ_TYPE_STANDARD EQU 0
CYDEV_STACK_SIZE EQU 0x0200
CYDEV_USE_BUNDLED_CMSIS EQU 1
CYDEV_VARIABLE_VDDA EQU 1
CYDEV_VDD_MV EQU 3300
CYDEV_WDT_GENERATE_ISR EQU 0
CYIPBLOCK_m0s8cpussv3_VERSION EQU 1
CYIPBLOCK_m0s8csdv2_VERSION EQU 1
CYIPBLOCK_m0s8ioss_VERSION EQU 1
CYIPBLOCK_m0s8lcd_VERSION EQU 2
CYIPBLOCK_m0s8lpcomp_VERSION EQU 2
CYIPBLOCK_m0s8peri_VERSION EQU 1
CYIPBLOCK_m0s8scb_VERSION EQU 2
CYIPBLOCK_m0s8tcpwm_VERSION EQU 2
CYIPBLOCK_m0s8wco_VERSION EQU 1
CYIPBLOCK_s8srsslt_VERSION EQU 1
CYDEV_BOOTLOADER_ENABLE EQU 0
    ENDIF
    END
